## sdkconfig.defaults
```kconfig
# CylinderIQ Hub V2 — sdkconfig.defaults (shared S3 + C6)

# FreeRTOS tick rate
CONFIG_FREERTOS_HZ=1000

# Newlib reentrant
CONFIG_NEWLIB_STDIN_LINE_ENDING_CR=y

# Logging
CONFIG_LOG_DEFAULT_LEVEL_DEBUG=y
CONFIG_LOG_MAXIMUM_LEVEL_DEBUG=y

# UART
CONFIG_UART_ISR_IN_IRAM=y

# Increase main task stack
CONFIG_ESP_MAIN_TASK_STACK_SIZE=8192

# JSON / HTTP
CONFIG_HTTPD_MAX_REQ_HDR_LEN=1024
CONFIG_HTTPD_MAX_URI_LEN=512
CONFIG_HTTPD_ERR_RESP_NO_DELAY=y

# cJSON
CONFIG_CJSON_ENABLE=y
```
